/*
 * Copyright (c) 2017 MediaTek Inc.
 *
 * This program is free software; you can redistribute it and/or modify
 * it under the terms of the GNU General Public License version 2 as
 * published by the Free Software Foundation.
 *
 * This program is distributed in the hope that it will be useful,
 * but WITHOUT ANY WARRANTY; without even the implied warranty of
 * MERCHANTABILITY or FITNESS FOR A PARTICULAR PURPOSE.  See the
 * GNU General Public License for more details.
 */

#include <dt-bindings/interrupt-controller/arm-gic.h>
#include <dt-bindings/interrupt-controller/irq.h>
#include <dt-bindings/mmc/mt6570-msdc.h>
#include "mt6570-pinfunc.h"
#include <generated/autoconf.h>

#ifdef CONFIG_MTK_DTBO_FEATURE
/dts-v1/;
#endif

/ {
	model = "MT6570";
	compatible = "mediatek,MT6570";
	interrupt-parent = <&gic>;
	#address-cells = <2>;
	#size-cells = <2>;

	/* chosen */
	chosen: chosen {
		bootargs = "console=tty0 console=ttyMT0,921600n1 root=/dev/ram initrd=0x84000000,0x400000 loglevel=8";
	};
mtk-msdc.0 {
			compatible = "simple-bus";
			#address-cells = <1>;
			#size-cells = <1>;
			ranges = <0 0 0 0xffffffff>;

			mmc0: msdc0@11120000 {
				compatible = "mediatek,mt6570-mmc";
				reg = <0x11120000 0x10000/*MSDC0_BASE*/
					0x10001e84 0x2>;/*FPGA PWR_GPIO,PWR_GPIO_EO*/
				interrupts = <GIC_SPI 38 IRQ_TYPE_LEVEL_LOW>;
				status = "disabled";
				/* peter check when rainier ccf ready
				clocks = <&perisys PERI_MSDC30_0>,
					 <&topckgen TOP_MUX_MSDC30_0>,
					 <&topckgen TOP_MSDCPLL_CK>,
					 <&topckgen TOP_MSDCPLL_D2>,
					 <&topckgen TOP_MSDCPLL_D4>;
				clock-names="MSDC0-CLOCK",
					"MSDC0_PLL_SEL",
					"MSDC0_PLL_800M",
					"MSDC0_PLL_400M",
					"MSDC0_PLL_200M"; */
			};

			mmc1: msdc1@11130000 {
				compatible = "mediatek,mt6570-mmc";
				reg = <0x11130000 0x10000/*MSDC1_BASE*/
					0x10001e84 0x2>;/*FPGA PWR_GPIO,PWR_GPIO_EO*/
				interrupts = <GIC_SPI 39 IRQ_TYPE_LEVEL_LOW>;
				cd-gpios = <&pio 3 0>;
				status = "disabled";
				/* peter check when rainier ccf ready
				clocks = <&perisys PERI_MSDC30_1>;
				clock-names="MSDC1-CLOCK"; */
			};

			msdc1_ins: default {
				compatible = "mediatek,msdc1_ins-eint";
			};
		};

	cpus {
		#address-cells = <1>;
		#size-cells = <0>;
		enable-method = "mediatek,mt6570-smp";
		cpu0: cpu@0 {
			device_type = "cpu";
			compatible = "arm,cortex-a7";
			reg = <0x000>;
			clock-frequency = <1700000000>;
		};
		cpu1: cpu@1 {
			device_type = "cpu";
			compatible = "arm,cortex-a7";
			reg = <0x001>;
			clock-frequency = <1700000000>;
		};
	};

	pmu {
		compatible = "arm,cortex-a7-pmu";
		interrupts = <GIC_SPI 4 IRQ_TYPE_LEVEL_LOW>,
			<GIC_SPI 5 IRQ_TYPE_LEVEL_LOW>;
	};

	timer {
		compatible = "arm,armv7-timer";
		interrupts = <GIC_PPI 13 IRQ_TYPE_LEVEL_LOW>, /*Secure Physical Timer Event*/
			<GIC_PPI 14 IRQ_TYPE_LEVEL_LOW>, /*Non-Secure Physical Timer Event*/
			<GIC_PPI 11 IRQ_TYPE_LEVEL_LOW>, /*Virtual Timer Event*/
			<GIC_PPI 10 IRQ_TYPE_LEVEL_LOW>; /*Hypervisor Timer Event*/
			clock-frequency = <13000000>;
	};

	memory {
		device_type = "memory";
		reg = <0 0x80000000 0 0x20000000>;
	};

	reserved_memory: reserved-memory {
		#address-cells = <2>;
		#size-cells = <2>;
		ranges;

		consys-reserve-memory {
			compatible = "mediatek,consys-reserve-memory";
			no-map;
			size = <0 0x200000>;
			alignment = <0 0x200000>;
		};

		pstore-reserved-memory@83f10000 {
			compatible = "mediatek,pstore";
			reg = <0 0x83f10000 0 0xe0000>;
		};

		ram_console-reserved-memory@83f00000 {
			compatible = "mediatek,ram_console";
			reg = <0 0x83f00000 0 0x10000>;
		};

		minirdump-reserved-memory@83ff0000 {
			compatible = "mediatek, minirdump";
			reg = <0 0x83ff0000 0 0x10000>;
		};
	};

	gic: interrupt-controller@40001000 {
		compatible = "arm,cortex-a7-gic";
		#interrupt-cells = <3>;
		#address-cells = <0>;
		interrupt-controller;
		reg = <0 0x10211000 0 0x1000>,
			<0 0x10212000 0 0x1000>,
			<0 0x10200100 0 0x1000>;
		interrupts = <1 9 0xf04>;

	};


	topckgen@10000000 {
		compatible = "mediatek,topckgen";
		reg = <0 0x10000000 0 0x1000>;
	};

	infracfg_ao@10001000 {
		compatible = "mediatek,infracfg_ao";
		reg = <0 0x10001000 0 0x1000>;
	};

	pericfg@10003000 {
		compatible = "mediatek,pericfg";
		reg = <0 0x10003000 0 0x1000>;
	};

	pio: pinctrl@10005000 {
		compatible = "mediatek,mt6570-pinctrl";
		reg = <0x0 0x10005000 0x0 0x1000>;
		mediatek,pctl-regmap = <&syscfg_pctl_a>;
		pins-are-numbered;
		gpio-controller;
		#gpio-cells = <2>;
	};

	gpio_usage_mapping:gpio {
		compatible = "mediatek,gpio_usage_mapping";
	};

	gpio@10005000 {
		compatible = "mediatek,gpio";
		reg = <0 0x10005000 0 0x1000>;
	};

	sleep@10006000 {
		compatible = "mediatek,sleep";
		reg = <0 0x10006000 0 0x1000>;
		interrupts = <GIC_SPI 88 IRQ_TYPE_LEVEL_LOW>,
			     <GIC_SPI 89 IRQ_TYPE_LEVEL_LOW>;
	};

	toprgu@10007000 {
		compatible = "mediatek,toprgu";
		reg = <0 0x10007000 0 0x1000>;
		interrupts = <GIC_SPI 157 IRQ_TYPE_EDGE_FALLING>;
	};

	apxgpt@10008000 {
		compatible = "mediatek,apxgpt";
		reg = <0 0x10008000 0 0x1000>;
		interrupts = <GIC_SPI 92 IRQ_TYPE_LEVEL_LOW>;
		clock-frequency = <13000000>;
	};

	efusec@10009000 {
		compatible = "mediatek,efusec";
		reg = <0 0x10009000 0 0x1000>;
	};

	sej@1000a000 {
		compatible = "mediatek,sej";
		reg = <0 0x1000a000 0 0x1000>;
		interrupts = <GIC_SPI 110 IRQ_TYPE_NONE>;
	};

		eintc: eintc@1000b000 {
			compatible = "mediatek,mt-eic";
			reg = <0 0x1000b000 0 0x1000>;
			interrupts = <GIC_SPI 94 IRQ_TYPE_LEVEL_HIGH>;

			#interrupt-cells = <2>;
			interrupt-controller;

			mediatek,max_eint_num = <26>;
			mediatek,mapping_table_entry = <83>;
			mediatek,mapping_table = <0 0>, /* <gpio_pin, eint_pin> */
					<1 1>,
					<2 2>,
					<3 3>,
					<4 4>,
					<5 5>,
					<6 6>,
					<7 7>,
					<8 8>,
					<9 9>,
					<10 10>,
					<11 11>,
					<12 12>,
					<13 13>,
					<14 14>,
					<15 15>,
					<16 0>,
					<17 1>,
					<18 2>,
					<19 3>,
					<20 4>,
					<21 5>,
					<22 6>,
					<23 7>,
					<24 8>,
					<25 9>,
					<26 10>,
					<27 11>,
					<28 12>,
					<29 13>,
					<30 14>,
					<31 15>,
					<32 0>,
					<33 1>,
					<34 2>,
					<35 3>,
					<36 4>,
					<37 5>,
					<38 6>,
					<39 7>,
					<40 8>,
					<41 9>,
					<42 10>,
					<43 11>,
					<44 12>,
					<45 13>,
					<46 14>,
					<47 15>,
					<48 0>,
					<49 1>,
					<50 2>,
					<51 3>,
					<52 3>,
					<53 4>,
					<54 5>,
					<55 6>,
					<56 7>,
					<57 8>,
					<58 10>,
					<59 11>,
					<60 12>,
					<61 13>,
					<62 14>,
					<63 15>,
					<64 0>,
					<65 1>,
					<66 2>,
					<67 3>,
					<68 16>,
					<69 4>,
					<70 5>,
					<71 6>,
					<72 7>,
					<73 8>,
					<74 9>,
					<75 10>,
					<76 11>,
					<77 12>,
					<78 13>,
					<81 0>,
					<82 1>,
					<83 2>,
					<84 3>;

			/* the number of gpio/eint mapping might be affected by built-in eint */
			mediatek,builtin_entry = <11>;
			/* gpio, built-in func mode, built-in eint */
			mediatek,builtin_mapping = <0 3 20>, /* USB IDDIG & USB VBUS */
						 <1 3 18>,
						 <7 4 20>,
						 <8 4 18>,
						 <9 3 20>,
						 <10 3 18>,
						 <24 5 20>,
						 <25 5 18>,
						 <77 2 20>,
						 <78 2 18>,
						 <13 1 17>; /* PMIC */
	};

	ap_ccif0@1000c000 {
		compatible = "mediatek,ap_ccif0";
		reg = <0 0x1000c000 0 0x1000>,	/*AP_CCIF_BASE*/
		      <0 0x1000d000 0 0x1000>;	/*MD_CCIF_BASE*/
		interrupts = <GIC_SPI 93 IRQ_TYPE_LEVEL_LOW>, /* CCIF0 IRQ */
			     <GIC_SPI 152 IRQ_TYPE_EDGE_FALLING>;/* MD WDT IRQ */
		mediatek,ccif_capability = <2>;
		mediatek,md_smem_size = <0x200000>; /* md share memory size */
	};

	md_ccif0@a000d000 {
		compatible = "mediatek,md_ccif0";
		reg = <0 0xa000d000 0 0x1000>;
	};

	aes@1000e000 {
		compatible = "mediatek,aes";
		reg = <0 0x1000e000 0 0x1000>;
	};

	iocfg_t@10014000 {
		compatible = "mediatek,iocfg_t";
		reg = <0 0x10014000 0 0x1000>;
	};

	iocfg_b@10015000 {
		compatible = "mediatek,iocfg_b";
		reg = <0 0x10015000 0 0x1000>;
	};

	iocfg_l@10016000 {
		compatible = "mediatek,iocfg_l";
		reg = <0 0x10016000 0 0x1000>;
	};

	iocfg_r@10017000 {
		compatible = "mediatek,iocfg_r";
		reg = <0 0x10017000 0 0x1000>;
	};

	cpu_dbgapb: cpu_dbgapb@10170000 {
		compatible = "mediatek,hw_dbg";
		num = <2>;
		reg = <0 0x10170000 0 0x2000>,
		      <0 0x10172000 0 0x2000>;
	};

	audio@11140000 {
			compatible = "mediatek,audio";
			reg = <0 0x11140000 0 0x10000>;
			interrupts = <0 80 0x8>;
		};

	audgpio:mt_soc_dl1_pcm@11140000 {
			compatible = "mediatek,mt_soc_pcm_dl1";
			reg = <0 0x11140000 0 0x1000>;
			interrupts = <0 80 0x8>;
			audclk-gpio = <26 0>;
			audmiso-gpio = <28 0>;
			audmosi-gpio = <27 0>;
		};

	mt_soc_ul1_PCM {
		compatible = "mediatek,mt_soc_pcm_capture";
	};

	mt_soc_voice_md1 {
		compatible = "mediatek,mt_soc_pcm_voice_md1";
	};

	mt_soc_hdmi_pcm {
		compatible = "mediatek,mt_soc_pcm_hdmi";
	};

	mt_soc_uldlloopback_pcm {
		compatible = "mediatek,mt_soc_pcm_uldlloopback";
	};

	mt_soc_i2s0_pcm {
		compatible = "mediatek,mt_soc_pcm_dl1_i2s0";
	};

	mt_soc_mrgrx_pcm {
		compatible = "mediatek,mt_soc_pcm_mrgrx";
	};

	mt_soc_mrgrx_awb_pcm {
		compatible = "mediatek,mt_soc_pcm_mrgrx_awb";
	};

	mt_soc_fm_i2s_pcm {
		compatible = "mediatek,mt_soc_pcm_fm_i2s";
	};

	mt_soc_fm_i2s_awb_pcm {
		compatible = "mediatek,mt_soc_pcm_fm_i2s_awb";
	};

	mt_soc_i2s0dl1_pcm {
		compatible = "mediatek,mt_soc_pcm_dl1_i2s0Dl1";
	};

	mt_soc_deep_buffer_dl_pcm {
		compatible = "mediatek,mt_soc_pcm_deep_buffer_dl";
	};

	mt_soc_dl1_awb_pcm {
		compatible = "mediatek,mt_soc_pcm_dl1_awb";
	};

	mt_soc_voice_md1_bt {
		compatible = "mediatek,mt_soc_pcm_voice_md1_bt";
	};

	mt_soc_voip_bt_out {
		compatible = "mediatek,mt_soc_pcm_dl1_bt";
	};

	mt_soc_voip_bt_in {
		compatible = "mediatek,mt_soc_pcm_bt_dai";
	};

	mt_soc_tdmrx_pcm {
		compatible = "mediatek,mt_soc_tdm_capture";
	};

	mt_soc_fm_mrgtx_pcm {
		compatible = "mediatek,mt_soc_pcm_fmtx";
	};

	mt_soc_ul2_pcm {
		compatible = "mediatek,mt_soc_pcm_capture2";
	};

	mt_soc_i2s0_awb_pcm {
		compatible = "mediatek,mt_soc_pcm_i2s0_awb";
	};

	mt_soc_voice_md2 {
		compatible = "mediatek,mt_soc_pcm_voice_md2";
	};

	mt_soc_routing_pcm {
		compatible = "mediatek,mt_soc_pcm_routing";
	};

	mt_soc_voice_md2_bt {
		compatible = "mediatek,mt_soc_pcm_voice_md2_bt";
	};

	mt_soc_hp_impedance_pcm {
		compatible = "mediatek,Mt_soc_pcm_hp_impedance";
	};

	mt_soc_codec_name {
		compatible = "mediatek,mt_soc_codec_63xx";
	};

	mt_soc_dummy_pcm {
		compatible = "mediatek,mt_soc_pcm_dummy";
	};

	mt_soc_codec_dummy_name {
		compatible = "mediatek,mt_soc_codec_dummy";
	};

	mt_soc_routing_dai_name {
		compatible = "mediatek,mt_soc_dai_routing";
	};

	mt_soc_dai_name {
		compatible = "mediatek,mt_soc_dai_stub";
	};

	mt_soc_dl2_pcm {
		compatible = "mediatek,mt_soc_pcm_dl2";
	};

	pwrap@1000f000 {
		compatible = "mediatek,pwrap";
		reg = <0 0x1000f000 0 0x1000>;
		interrupts = <GIC_SPI 108 IRQ_TYPE_NONE>;
		mt6350_pmic: pmic {
			compatible = "mediatek,mt6350-pmic";
			interrupt-controller;
		};
	};

	devapc_ao@10010000 {
		compatible = "mediatek,devapc_ao";
		reg = <0 0x10010000 0 0x1000>;
	};

	mipi_rx_ana@10011800 {
		compatible = "mediatek,mipi_rx_ana";
		reg = <0 0x10011800 0 0x1000>;
	};

	infra_mbist@10012000 {
		compatible = "mediatek,infra_mbist";
		reg = <0 0x10012000 0 0x1000>;
	};

	apmixedsys@10018000 {
		compatible = "mediatek,apmixed";
		reg = <0 0x10018000 0 0x1000>;
	};

	keypad: keypad@10002000 {
		compatible = "mediatek,mt6570-keypad";
		reg = <0 0x10002000 0 0x1000>;
		interrupts = <0 109 0x2>;
	};
	dbgapb@10100000 {
		compatible = "mediatek,dbgapb";
		reg = <0 0x10100000 0 0x1000>;
	};

	mcucfg@10200000 {
		compatible = "mediatek,mcucfg";
		reg = <0 0x10200000 0 0x1000>;
	};

	infracfg@10201000 {
		compatible = "mediatek,infracfg";
		reg = <0 0x10201000 0 0x1000>;
	};

	sys_cirq@10202000 {
		compatible = "mediatek,mt6580-sys_cirq", "mediatek,mt6735-sys_cirq";
		reg = <0 0x10202000 0 0x1000>;
		interrupts = <GIC_SPI 158 IRQ_TYPE_LEVEL_LOW>;
		mediatek,cirq_num = <126>;
		mediatek,spi_start_offset = <32>;
	};

	m4u@10203000 {
		cell-index = <0>;
		compatible = "mediatek,m4u";
		reg = <0 0x10203000 0 0x1000>;
		interrupts =  <GIC_SPI 81 IRQ_TYPE_LEVEL_LOW>;
	};

	nb_mmu0@10203200 {
		compatible = "mediatek,nb_mmu0";
		reg = <0 0x10203200 0 0x1000>;
	};

	nb_mmu1@10203800 {
		compatible = "mediatek,nb_mmu1";
		reg = <0 0x10203800 0 0x1000>;
	};

	devapc@10204000 {
		compatible = "mediatek,devapc";
		reg = <0 0x10204000 0 0x1000>;
		interrupts = <GIC_SPI 74 IRQ_TYPE_LEVEL_LOW>;
	};

	emi@10205000 {
		compatible = "mediatek,emi";
		reg = <0 0x10205000 0 0x1000>;
		interrupts = <GIC_SPI 76 IRQ_TYPE_LEVEL_HIGH>;
	};

	dramc_nao@10206000 {
		compatible = "mediatek,dramc_nao";
		reg = <0 0x10206000 0 0x1000>;
	};

	dramc0@10207000 {
		compatible = "mediatek,dramc0";
		reg = <0 0x10207000 0 0x1000>;
	};

	ddrphy@10208000 {
		compatible = "mediatek,ddrphy";
		reg = <0 0x10208000 0 0x1000>;
	};

	sramrom@10209000 {
		compatible = "mediatek,sramrom";
		reg = <0 0x10209000 0 0x1000>;
	};

	gce@1020a000 {
		compatible = "mediatek,gce";
		reg = <0 0x1020a000 0 0x1000>;
		interrupts = <GIC_SPI 85 IRQ_TYPE_LEVEL_LOW>,
			<GIC_SPI 86 IRQ_TYPE_LEVEL_LOW>;
		disp_mutex_reg = <0x14015000 0x1000>;
		g3d_config_base = <0x13000000 0 0xffff0000>;
		mmsys_config_base = <0x14000000 1 0xffff0000>;
		disp_dither_base = <0x14010000 2 0xffff0000>;
		mm_na_base = <0x14020000 3 0xffff0000>;
		imgsys_base = <0x15000000 4 0xffff0000>;
		vdec_gcon_base = <0x16000000 5 0xffff0000>;
		venc_gcon_base = <0x17000000 6 0xffff0000>;
		conn_peri_base = <0x18000000 7 0xffff0000>;
		topckgen_base = <0x10000000 8 0xffff0000>;
		kp_base = <0x10010000 9 0xffff0000>;
		scp_sram_base = <0x10020000 10 0xffff0000>;
		infra_na3_base = <0x10030000 11 0xffff0000>;
		infra_na4_base = <0x10040000 12 0xffff0000>;
		scp_base = <0x10050000 13 0xffff0000>;
		mcucfg_base = <0x10200000 14 0xffff0000>;
		gcpu_base = <0x10210000 15 0xffff0000>;
		usb0_base = <0x11200000 16 0xffff0000>;
		usb_sif_base = <0x11210000 17 0xffff0000>;
		audio_base = <0x11220000 18 0xffff0000>;
		msdc0_base = <0x11230000 19 0xffff0000>;
		msdc1_base = <0x11250000 20 0xffff0000>;
		msdc2_base = <0x11250000 21 0xffff0000>;
		msdc3_base = <0x11260000 22 0xffff0000>;
		pwm_sw_base = <0x1100F000 99 0xfffff000>;
		mdp_rdma0_sof = <0>;
		mdp_rsz0_sof = <1>;
		mdp_rsz1_sof = <2>;
		mdp_tdshp_sof = <3>;
		mdp_wdma_sof = <4>;
		mdp_wrot_sof = <5>;
		disp_ovl0_sof = <6>;
		disp_rdma0_sof = <8>;
		disp_rdma1_sof = <9>;
		disp_wdma0_sof = <10>;
		disp_ccorr_sof = <11>;
		disp_color_sof = <12>;
		disp_aal_sof = <13>;
		disp_gamma_sof = <14>;
		disp_dither_sof = <15>;
		disp_ufoe_sof = <16>;
		disp_pwm0_sof = <17>;
		mdp_rdma0_frame_done = <18>;
		mdp_rsz0_frame_done = <19>;
		mdp_rsz1_frame_done = <20>;
		mdp_tdshp_frame_done = <21>;
		mdp_wdma_frame_done = <22>;
		mdp_wrot_write_frame_done = <23>;
		mdp_wrot_read_frame_done = <24>;
		disp_ovl0_frame_done = <25>;
		disp_ovl1_frame_done = <26>;
		disp_rdma0_frame_done = <27>;
		disp_rdma1_frame_done = <28>;
		disp_wdma0_frame_done = <29>;
		disp_ccorr_frame_done = <30>;
		disp_color_frame_done = <31>;
		disp_aal_frame_done = <32>;
		disp_gamma_frame_done = <33>;
		disp_dither_frame_done = <34>;
		disp_ufoe_frame_done = <35>;
		disp_dsi0_frame_done = <37>;
		stream_done_0 = <38>;
		stream_done_1 = <39>;
		stream_done_2 = <40>;
		stream_done_3 = <41>;
		stream_done_4 = <42>;
		stream_done_5 = <43>;
		stream_done_6 = <44>;
		stream_done_7 = <45>;
		stream_done_8 = <46>;
		stream_done_9 = <47>;
		buf_underrun_event_0 = <48>;
		dsi0_te_event = <50>;
		isp_frame_done_p2_1 = <66>;
		isp_frame_done_p2_0 = <67>;
		seninf_cam0_fifo_full = <73>;
		apxgpt2_count = <0x10008028>;
	};

	cq_dma@1020ac00 {
		compatible = "mediatek,cq_dma";
		reg = <0 0x1020ac00 0 0x1000>;
	};

	dbg_tracker@1020b000 {
		compatible = "mediatek,dbg_tracker";
		reg = <0 0x1020b000 0 0x1000>;
	};

	trng@1020c000 {
		compatible = "mediatek,trng";
		reg = <0 0x1020c000 0 0x1000>;
		interrupts = <GIC_SPI 87 IRQ_TYPE_LEVEL_LOW>;
	};

	mcu_biu_cfg@1020d000 {
		compatible = "mediatek,mcu_biu_cfg";
		reg = <0 0x1020d000 0 0x1000>;
	};

	ca9@10210000 {
		compatible = "mediatek,ca9";
		reg = <0 0x10210000 0 0x1000>;
	};

	syscfg_pctl_a: syscfg_pctl_a@10211000 {
		compatible = "mediatek,mt6570-pctl-a-syscfg", "syscon";
		reg = <0x0 0x10211000 0x0 0x1000>;
	};

	ufozip@11010000 {
		compatible = "mediatek,ufozip";
		reg = <0 0x11010000 0 0x4000>;
		interrupts = <GIC_SPI 68 IRQ_TYPE_LEVEL_LOW>;
	};

	ap_dma@11000000 {
		compatible = "mediatek,ap_dma";
		reg = <0 0x11000000 0 0x1000>;
		interrupts = <GIC_SPI 48 IRQ_TYPE_LEVEL_LOW>;
	};

	ap_dma_uart0_tx@11000480 {
		compatible = "mediatek,AP_DMA_UART0_TX";
		reg = <0 0x11000480 0 0x80>;
		interrupts = <GIC_SPI 56 IRQ_TYPE_LEVEL_LOW>;
	};

	ap_dma_uart0_rx@11000500 {
		compatible = "mediatek,AP_DMA_UART0_RX";
		reg = <0 0x11000500 0 0x80>;
		interrupts = <GIC_SPI 57 IRQ_TYPE_LEVEL_LOW>;
	};

	ap_dma_uart1_tx@11000580 {
		compatible = "mediatek,AP_DMA_UART1_TX";
		reg = <0 0x11000580 0 0x80>;
		interrupts = <GIC_SPI 58 IRQ_TYPE_LEVEL_LOW>;
	};

	ap_dma_uart1_rx@11000600 {
		compatible = "mediatek,AP_DMA_UART1_RX";
		reg = <0 0x11000600 0 0x80>;
		interrupts = <GIC_SPI 59 IRQ_TYPE_LEVEL_LOW>;
	};

	nfi@11001000 {
		compatible = "mediatek,nfi";
		reg = <0 0x11001000 0 0x1000>;
		interrupts = <GIC_SPI 47 IRQ_TYPE_LEVEL_LOW>;
	};

	nfiecc@11002000 {
		compatible = "mediatek,nfiecc";
		reg = <0 0x11002000 0 0x1000>;
		interrupts = <GIC_SPI 46 IRQ_TYPE_LEVEL_LOW>;
	};

	auxadc: adc_hw@11003000 {
		compatible = "mediatek,ap-auxadc";
		reg = <0 0x11003000 0 0x1000>;
		interrupts = <GIC_SPI 35 IRQ_TYPE_EDGE_FALLING>;
	};

	fhctl@11004000 {
		compatible = "mediatek,fhctl";
		reg = <0 0x11004000 0 0x1000>;
	};

	ap_uart0@11005000 {
		cell-index = <0>;
		compatible = "mediatek,AP_UART0";
		reg = <0 0x11005000 0 0x1000>;
		interrupts = <GIC_SPI 44 IRQ_TYPE_LEVEL_LOW>;
	};

	ap_uart1@11006000 {
		cell-index = <1>;
		compatible = "mediatek,AP_UART1";
		reg = <0 0x11006000 0 0x1000>;
		interrupts = <GIC_SPI 45 IRQ_TYPE_LEVEL_LOW>;
	};

	pwm@11008000 {
		compatible = "mediatek,pwm";
		reg = <0 0x11008000 0 0x1000>;
		interrupts = <GIC_SPI 36 IRQ_TYPE_LEVEL_LOW>;
	};

	i2c0: i2c0@11009000 {
		compatible = "mediatek,mt6570-i2c";
		cell-index = <0>;
		reg = <0 0x11009000 0 0x1000>;
		interrupts = <GIC_SPI 40 IRQ_TYPE_LEVEL_LOW>;
		clock-div = <10>;
		#address-cells = <1>;
		#size-cells = <0>;
	};

	i2c1: i2c1@1100a000 {
		compatible = "mediatek,mt6570-i2c";
		cell-index = <1>;
		reg = <0 0x1100a000 0 0x1000>;
		interrupts = <GIC_SPI 41 IRQ_TYPE_LEVEL_LOW>;
		clock-div = <10>;
		#address-cells = <1>;
		#size-cells = <0>;
	};

	i2c2: i2c2@1100b000 {
		compatible = "mediatek,mt6570-i2c";
		cell-index = <2>;
		reg = <0 0x1100b000 0 0x1000>;
		interrupts = <GIC_SPI 42 IRQ_TYPE_LEVEL_LOW>;
		clock-div = <10>;
		#address-cells = <1>;
		#size-cells = <0>;
	};

	touch: touch@0 {
		compatible = "mediatek,mt6570-touch";
		vtouch-supply = <&mt_pmic_vgp1_ldo_reg>;
	};

	accdet: accdet {
		compatible = "mediatek,mt6570-accdet";
	};
/* sensor part */
		hwmsensor@0 {
			compatible = "mediatek,hwmsensor";
		};
		gsensor@0 {
			compatible = "mediatek,gsensor";
		};
		alsps:als_ps@0 {
			compatible = "mediatek,als_ps";
		};
		m_batch_pl@0 {
			compatible = "mediatek,m_batch_pl";
		};
		batchsensor@0 {
			compatible = "mediatek,batchsensor";
		};
		m_acc_pl@0 {
			compatible = "mediatek,m_acc_pl";
		};
		m_alsps_pl@0 {
			compatible = "mediatek,m_alsps_pl";
		};
		gyro:gyroscope@0 {
			compatible = "mediatek,gyroscope";
		};
		m_gyro_pl@0 {
			compatible = "mediatek,m_gyro_pl";
		};
		barometer@0 {
			compatible = "mediatek,barometer";
		};
		m_baro_pl@0 {
			compatible = "mediatek,m_baro_pl";
		};
		msensor@0 {
			compatible = "mediatek,msensor";
		};
		m_mag_pl@0 {
			compatible = "mediatek,m_mag_pl";
		};
		orientation@0 {
			compatible = "mediatek,orientation";
		};
		als: als {
			compatible = "mediatek, als-eint";
		};
		gse_1: gse_1 {
			compatible = "mediatek, gse_1-eint";
			status = "disabled";
		};

/* sensor end */

	spi@1100c000 {
		compatible = "mediatek,mt6570-spi";
		cell-index = <0>;
		reg = <0 0x1100c000 0 0x1000>;
		interrupts = <GIC_SPI 64 IRQ_TYPE_LEVEL_LOW>;
		mediatek,spi-padmacro = <0>;
	};

	therm_ctrl@1100d000 {
		compatible = "mediatek,therm_ctrl";
		reg = <0 0x1100d000 0 0x1000>;
		interrupts = <GIC_SPI 37 IRQ_TYPE_LEVEL_LOW>;
	};

	btif_tx:btif_tx@11000380 {
		compatible = "mediatek,btif_tx";
		reg = <0 0x11000380 0 0x80>;
		interrupts = <GIC_SPI 54 IRQ_TYPE_LEVEL_LOW>;
	};

	btif_rx:btif_rx@11000400 {
		compatible = "mediatek,btif_rx";
		reg = <0 0x11000400 0 0x80>;
		interrupts = <GIC_SPI 55 IRQ_TYPE_LEVEL_LOW>;
	};

	btif:btif@1100e000 {
		compatible = "mediatek,btif";
		reg = <0 0x1100e000 0 0x1000>;
		interrupts = <GIC_SPI 67 IRQ_TYPE_LEVEL_LOW>;
		/*clocks = <&perisys PERI_BTIF>,<&perisys PERI_APDMA>;*/
		/*clock-names = "btifc","apdmac";*/
	};/* End of btif */

	consys:consys@18070000 {
		compatible = "mediatek,mt6570-consys";
		reg =	<0 0x18070000 0 0x0200>,	/*CONN_MCU_CONFIG_BASE*/
			<0 0x10007000 0 0x0100>,	/*AP_RGU_BASE*/
			<0 0x10000000 0 0x2000>,	/*TOPCKGEN_BASE*/
			<0 0x10006000 0 0x1000>,	/*SPM_BASE*/
			<0 0x10005000 0 0x1000>;	/*DA_XOBUF*/
		interrupts = <GIC_SPI 154 IRQ_TYPE_LEVEL_LOW>, /*BGF_EINT*/
			<GIC_SPI 156 IRQ_TYPE_LEVEL_LOW>; /*WDT_EINT*/
		/*clocks = <&scpsys SCP_SYS_CONN>,<&infrasys INFRA_CONNMCU_BUS>;*/
		/*clock-names = "conn","bus";*/
		vcn18-supply = <&mt_pmic_vcn_1v8_ldo_reg>;
		vcn28-supply = <&mt_pmic_vcn28_ldo_reg>;
		vcn33_bt-supply = <&mt_pmic_vcn33_bt_ldo_reg>;
		vcn33_wifi-supply = <&mt_pmic_vcn33_wifi_ldo_reg>;
	};

	wifi@180f0000 {
		compatible = "mediatek,wifi";
		reg = <0x180f0000 0x005c>;
		interrupts = <GIC_SPI 155 IRQ_TYPE_LEVEL_LOW>;
	};

	gps {
	    compatible = "mediatek,gps";
	};

	disp_pwm@1100f000 {
		compatible = "mediatek,disp_pwm";
		reg = <0 0x1100f000 0 0x1000>;
		interrupts = <GIC_SPI 33 IRQ_TYPE_LEVEL_LOW>;
	};

	usb0:usb@11100000 {
		compatible = "mediatek,usb0";
		cell-index = <0>;
		reg = <0 0x11100000 0 0x10000>,
		<0 0x11110000 0 0x10000>;
		interrupts = <GIC_SPI 32 IRQ_TYPE_LEVEL_LOW>;
		mode = <2>;
		multipoint = <1>;
		dyn_fifo = <1>;
		soft_con = <1>;
		dma = <1>;
		num_eps = <16>;
		dma_channels = <8>;
		iddig_gpio = <7 4>;
		drvvbus_gpio = <8 4>;
	};

	usbphy:usbphy {
		compatible = "usb-nop-xceiv";
	};

	usb_sif@11110000 {
		compatible = "mediatek,usb_sif";
		reg = <0 0x11110000 0 0x1000>;
	};

	ahbabt@11150000 {
		compatible = "mediatek,ahbabt";
		reg = <0 0x11150000 0 0x1000>;
	};

	mdi@11160000 {
		compatible = "mediatek,mdi";
		reg = <0 0x11160000 0 0x1000>;
	};

	g3d_config@13000000 {
		compatible = "mediatek,g3d_config";
		reg = <0 0x13000000 0 0x1000>;
	};

	mali@13010000 {
		compatible = "mediatek,mali";
		reg = <0 0x13010000 0 0x1000>;
	};

	mali_tb@1301f000 {
		compatible = "mediatek,mali_tb";
		reg = <0 0x1301f000 0 0x1000>;
	};

	mmsys_config@14000000 {
		compatible = "mediatek,mmsys_config";
		reg = <0 0x14000000 0 0x1000>;
		interrupts = <GIC_SPI 132 IRQ_TYPE_LEVEL_LOW>;
	};

	mdp_rdma@14001000 {
		compatible = "mediatek,mdp_rdma";
		reg = <0 0x14001000 0 0x1000>;
		interrupts = <GIC_SPI 113 IRQ_TYPE_LEVEL_LOW>;
	};

	mdp_rsz0@14002000 {
		compatible = "mediatek,mdp_rsz0";
		reg = <0 0x14002000 0 0x1000>;
		interrupts = <GIC_SPI 114 IRQ_TYPE_LEVEL_LOW>;
	};

	mdp_rsz1@14003000 {
		compatible = "mediatek,mdp_rsz1";
		reg = <0 0x14003000 0 0x1000>;
		interrupts = <GIC_SPI 115 IRQ_TYPE_LEVEL_LOW>;
	};

	mdp_wdma@14004000 {
		compatible = "mediatek,mdp_wdma";
		reg = <0 0x14004000 0 0x1000>;
		interrupts = <GIC_SPI 117 IRQ_TYPE_LEVEL_LOW>;
	};

	mdp_wrot@14005000 {
		compatible = "mediatek,mdp_wrot";
		reg = <0 0x14005000 0 0x1000>;
		interrupts = <GIC_SPI 118 IRQ_TYPE_LEVEL_LOW>;
	};

	mdp_tdshp@14006000 {
		compatible = "mediatek,mdp_tdshp";
		reg = <0 0x14006000 0 0x1000>;
		interrupts = <GIC_SPI 116 IRQ_TYPE_LEVEL_LOW>;
	};

	lcm: lcm {
		compatible = "mediatek,mt6570-lcm";
	};

	dispsys: dispsys@0x14007000 {
		compatible = "mediatek,dispsys";
		reg = <0 0x14000000 0 0x1000>,	/*DISP_SYS */
		      <0 0x14007000 0 0x1000>,	/*DISP_OVL0*/
		      <0 0x14008000 0 0x1000>,	/*DISP_OVL1*/
		      <0 0x14009000 0 0x1000>,	/*DISP_RDMA0*/
		      <0 0x1400A000 0 0x1000>,	/*DISP_RDMA1*/
		      <0 0x1400B000 0 0x1000>,	/*DISP_WDMA0*/
		      <0 0x1400C000 0 0x1000>,	/*DISP_COLOR*/
		      <0 0x1400D000 0 0x1000>,	/*DISP_CCORR*/
		      <0 0x1400E000 0 0x1000>,	/*DISP_AAL*/
		      <0 0x1400F000 0 0x1000>,	/*DISP_GAMMA*/
		      <0 0x14010000 0 0x1000>,	/*DISP_DITHER*/
		      <0 0x14011000 0 0x1000>,	/*DISP_UFOE*/
		      <0 0x14012000 0 0x1000>,	/*DISP_DSI0*/
		      <0 0x14013000 0 0x1000>,	/*DISP_DPI0*/
		      <0 0x1100F000 0 0x1000>,	/*DISP_PWM*/
		      <0 0x14015000 0 0x1000>,	/*DISP_MUTEX*/
		      <0 0x14016000 0 0x1000>,	/*DISP_SMI_LARB0 */
		      <0 0x14017000 0 0x1000>,	/*DISP_SMI_COMMOM*/
		      <0 0x14018000 0 0x1000>;	/*MIPITX0,real chip would use this*/

		interrupts = <0 0 8>,   /*DISP_SYS */
			     <0 119 8>, /*DISP_OVL0 */
			     <0 0 8>,   /*DISP_OVL1 */
			     <0 121 8>, /*DISP_RDMA0 */
			     <0 0 8>,   /*DISP_RDMA1 */
			     <0 123 8>, /*DISP_WDMA0 */
			     <0 124 8>, /*DISP_COLOR */
			     <0 0 8>,   /*DISP_CCORR */
			     <0 126 8>, /*DISP_AAL */
			     <0 127 8>, /*DISP_GAMMA */
			     <0 128 8>, /*DISP_DITHER */
			     <0 0 8>,   /*DISP_UFOE */
			     <0 130 8>, /*DISP_DSI0 */
			     <0 0 8>,   /*DISP_DPI0 */
			     <0 0 8>,   /*DISP_PWM */
			     <0 112 8>, /*DISP_MUTEX */
			     <0 0 8>,   /*DISP_SMI_LARB0 */
			     <0 0 8>,   /*DISP_SMI_COMMOM*/
			     <0 0 8>;   /*MIPITX0*/
	};

	disp_ovl0@14007000 {
		compatible = "mediatek,disp_ovl0";
		reg = <0 0x14007000 0 0x1000>;
		interrupts = <GIC_SPI 119 IRQ_TYPE_LEVEL_LOW>;
	};

	disp_ovl1@14008000 {
		compatible = "mediatek,disp_ovl1";
		reg = <0 0x14008000 0 0x1000>;
	};

	disp_rdma0@14009000 {
		compatible = "mediatek,disp_rdma0";
		reg = <0 0x14009000 0 0x1000>;
		interrupts = <GIC_SPI 121 IRQ_TYPE_LEVEL_LOW>;
	};

	disp_rdma1@1400a000 {
		compatible = "mediatek,disp_rdma1";
		reg = <0 0x1400a000 0 0x1000>;
	};

	disp_wdma0@1400b000 {
		compatible = "mediatek,disp_wdma0";
		reg = <0 0x1400b000 0 0x1000>;
	};

	disp_color@1400c000 {
		compatible = "mediatek,disp_color";
		reg = <0 0x1400c000 0 0x1000>;
		interrupts = <GIC_SPI 124 IRQ_TYPE_LEVEL_LOW>;
	};

	disp_ccorr@1400d000 {
		compatible = "mediatek,disp_ccorr";
		reg = <0 0x1400d000 0 0x1000>;
	};

	disp_aal@1400e000 {
		compatible = "mediatek,disp_aal";
		reg = <0 0x1400e000 0 0x1000>;
		interrupts = <GIC_SPI 126 IRQ_TYPE_LEVEL_LOW>;
	};

	disp_gamma@1400f000 {
		compatible = "mediatek,disp_gamma";
		reg = <0 0x1400f000 0 0x1000>;
		interrupts = <GIC_SPI 127 IRQ_TYPE_LEVEL_LOW>;
	};

	disp_dither@14010000 {
		compatible = "mediatek,disp_dither";
		reg = <0 0x14010000 0 0x1000>;
		interrupts = <GIC_SPI 128 IRQ_TYPE_LEVEL_LOW>;
	};

	disp_ufoe@14011000 {
		compatible = "mediatek,disp_ufoe";
		reg = <0 0x14011000 0 0x1000>;
	};

	dsi0@14012000 {
		compatible = "mediatek,dsi0";
		reg = <0 0x14012000 0 0x1000>;
	};

	dpi0@14013000 {
		compatible = "mediatek,dpi0";
		reg = <0 0x14013000 0 0x1000>;
	};

	mm_mutex@14015000 {
		compatible = "mediatek,mm_mutex";
		reg = <0 0x14015000 0 0x1000>;
		interrupts = <GIC_SPI 112 IRQ_TYPE_LEVEL_LOW>;
	};

	smi_larb0@14016000 {
		compatible = "mediatek,smi_larb0";
		reg = <0 0x14016000 0 0x1000>;
		interrupts = <GIC_SPI 133 IRQ_TYPE_LEVEL_LOW>;
	};

	smi_common@14017000 {
		compatible = "mediatek,smi_common";
		reg = <0 0x14017000 0 0x1000>;
	};

	mipi_tx_config@14018000 {
		compatible = "mediatek,mipi_tx_config";
		reg = <0 0x14018000 0 0x1000>;
	};

	disp_wdma1@14038000 {
		compatible = "mediatek,disp_wdma1";
		reg = <0 0x14038000 0 0x1000>;
	};

	IMGSYS_CONFIG@15000000 {
		compatible = "mediatek,IMGSYS_CONFIG";
		reg = <0 0x15000000 0 0x1000>;
	};

	smi_larb1@15001000 {
		compatible = "mediatek,smi_larb1";
		reg = <0 0x15001000 0 0x1000>;
		interrupts = <GIC_SPI 136 IRQ_TYPE_LEVEL_LOW>;
	};

	CAM_0@0x15004000 {
		compatible = "mediatek,CAM_0";
		reg = <0 0x15004000 0 0x1000>;
		interrupts = <0 139 0x8>;
	};

	csi2@15008000 {
		compatible = "mediatek,csi2";
		reg = <0 0x15008000 0 0x1000>;
	};

	seninf@15008000 {
		compatible = "mediatek,seninf";
		reg = <0 0x15008000 0 0x1000>;
	};

	seninf_tg@15008000 {
		compatible = "mediatek,seninf_tg";
		reg = <0 0x15008000 0 0x1000>;
	};

	ISPSYS@0x15000000 {
		compatible = "mediatek,ISPSYS";
		reg = <0 0x15004000 0 0x9000>,	/*ISP_ADDR*/
		<0 0x15000000 0 0x10000>,	/*IMGSYS_CONFIG_ADDR*/
		<0 0x10011000 0 0x4000>,	/*MIPI_ANA_ADDR*/
		<0 0x10017000 0 0x1000>;
		interrupts = <0 142 0x8>, /* SENINF */
		<0 139 0x8>; /* CAM0 */
	};

	/*for sysram dev and pipemgr dev*/
	ISP_SYSR@0x15000000 {
		compatible = "mediatek,ISP_SYSR";
	};

	ISP_PIPEM@0x15000000 {
		compatible = "mediatek,ISP_PIPEM";
	};

	kd_camera_hw1:kd_camera_hw1@15008000 {
		compatible = "mediatek,camera_hw";
		reg = <0 0x15008000 0 0x1000>;  /* SENINF_ADDR */
		vcama-supply = <&mt_pmic_vcama_ldo_reg>;
		vcamd-supply = <&mt_pmic_vcamd_ldo_reg>;
		vcamaf-supply = <&mt_pmic_vcamaf_ldo_reg>;
		vcamio-supply = <&mt_pmic_vcamio_ldo_reg>;
	};

	kd_camera_hw2:kd_camera_hw2@15008000 {
		compatible = "mediatek,camera_hw2";
		reg = <0 0x15008000 0 0x1000>;  /* SENINF_ADDR */
	};

	seninf_top@15008000 {
		compatible = "mediatek,seninf_top";
		reg = <0 0x15008000 0 0x1000>;
		interrupts = <GIC_SPI 142 IRQ_TYPE_LEVEL_LOW>;
	};

	seninf_mux@15008000 {
		compatible = "mediatek,seninf_mux";
		reg = <0 0x15008000 0 0x1000>;
	};

	mipi_rx_config@15008000 {
		compatible = "mediatek,mipi_rx_config";
		reg = <0 0x15008000 0 0x1000>;
	};

	scam@15008c00 {
		compatible = "mediatek,scam";
		reg = <0 0x15008c00 0 0x1000>;
	};

	ncsi2@15008000 {
		compatible = "mediatek,ncsi2";
		reg = <0 0x15008000 0 0x1000>;
	};

	ccir656@15008000 {
		compatible = "mediatek,ccir656";
		reg = <0 0x15008000 0 0x1000>;
	};

	n3d_ctl@15008000 {
		compatible = "mediatek,n3d_ctl";
		reg = <0 0x15008000 0 0x1000>;
	};

	venc@15009000 {
		compatible = "mediatek,venc";
		reg = <0 0x15009000 0 0x1000>;
		interrupts = <GIC_SPI 138 IRQ_TYPE_LEVEL_LOW>;
	};

	jpgdec@1500a000 {
		compatible = "mediatek,jpgdec";
		reg = <0 0x1500a000 0 0x1000>;
	};

	vdec@1500b000 {
		compatible = "mediatek,vdec";
		reg = <0 0x1500b000 0 0x1000>;
		interrupts = <GIC_SPI 137 IRQ_TYPE_LEVEL_LOW>;
	};

	vdec_gcon@16000000 {
		compatible = "mediatek,vdec_gcon";
		reg = <0 0x16000000 0 0x1000>;
	};

	vdtop@16020000 {
		compatible = "mediatek,vdtop";
		reg = <0 0x16020000 0 0x1000>;
	};

	vld@16021000 {
		compatible = "mediatek,vld";
		reg = <0 0x16021000 0 0x1000>;
	};

	vld_top@16021800 {
		compatible = "mediatek,vld_top";
		reg = <0 0x16021800 0 0x1000>;
	};

	mc@16022000 {
		compatible = "mediatek,mc";
		reg = <0 0x16022000 0 0x1000>;
	};

	avc_vld@16023000 {
		compatible = "mediatek,avc_vld";
		reg = <0 0x16023000 0 0x1000>;
	};

	avc_mv@16024000 {
		compatible = "mediatek,avc_mv";
		reg = <0 0x16024000 0 0x1000>;
	};

	vdec_pp@16025000 {
		compatible = "mediatek,vdec_pp";
		reg = <0 0x16025000 0 0x1000>;
	};

	vp8_vld@16026800 {
		compatible = "mediatek,vp8_vld";
		reg = <0 0x16026800 0 0x1000>;
	};

	vp6@16027000 {
		compatible = "mediatek,vp6";
		reg = <0 0x16027000 0 0x1000>;
	};

	vld2@16027800 {
		compatible = "mediatek,vld2";
		reg = <0 0x16027800 0 0x1000>;
	};

	mc_vmmu@16028000 {
		compatible = "mediatek,mc_vmmu";
		reg = <0 0x16028000 0 0x1000>;
	};

	pp_vmmu@16029000 {
		compatible = "mediatek,pp_vmmu";
		reg = <0 0x16029000 0 0x1000>;
	};

	n3d_ctl@15000000 {
		compatible = "mediatek,n3d_ctl";
		reg = <0 0x15000000 0 0x1000>;
	};

	fdvt@1500b000 {
		compatible = "mediatek,fdvt";
		reg = <0 0x1500b000 0 0x1000>;
	};

	btcvsd@10001000 {
		compatible = "mediatek,audio_bt_cvsd";
	/*INFRA MISC, conn_bt_cvsd_mask, cvsd_mcu_read, write, packet_indicator*/
		offset =<0xC00 0x2 0xFD0 0xFD4 0xFD8>;
		reg=<0 0x10001000 0 0x1000>, /*AUDIO_INFRA_BASE_PHYSICAL*/
			<0 0x18000000 0 0x10000>, /*PKV_PHYSICAL_BASE*/
			<0 0x18080000 0 0x7800>; /*SRAM_BANK2*/
		interrupts = <0 153 0x8>;
	};

	alc@60000000 {
		compatible = "mediatek,alc";
		reg = <0 0x60000000 0 0x1000>;
	};

	md_config@80000000 {
		compatible = "mediatek,md_config";
		reg = <0 0x80000000 0 0x1000>;
	};

	md_cirq@80010000 {
		compatible = "mediatek,md_cirq";
		reg = <0 0x80010000 0 0x1000>;
	};

	md_eint@80010000 {
		compatible = "mediatek,md_eint";
		reg = <0 0x80010000 0 0x1000>;
	};

	mdmcu_mdm@80010000 {
		compatible = "mediatek,mdmcu_mdm";
		reg = <0 0x80010000 0 0x1000>;
	};

	md_topsm@80030000 {
		compatible = "mediatek,md_topsm";
		reg = <0 0x80030000 0 0x1000>;
	};

	md_ost@80040000 {
		compatible = "mediatek,md_ost";
		reg = <0 0x80040000 0 0x1000>;
	};

	md_rgu@80050000 {
		compatible = "mediatek,md_rgu";
		reg = <0 0x80050000 0 0x1000>;
		interrupts = <GIC_SPI 152 IRQ_TYPE_EDGE_FALLING>;
	};

	md_gpt@80060000 {
		compatible = "mediatek,md_gpt";
		reg = <0 0x80060000 0 0x1000>;
	};

	md_uart1@80070000 {
		compatible = "mediatek,md_uart1";
		reg = <0 0x80070000 0 0x1000>;
	};

	md_debug@80090000 {
		compatible = "mediatek,md_debug";
		reg = <0 0x80090000 0 0x1000>;
	};

	md_p_dma@800b0000 {
		compatible = "mediatek,md_p_dma";
		reg = <0 0x800b0000 0 0x1000>;
	};

	simif0@800c0000 {
		compatible = "mediatek,simif0";
		reg = <0 0x800c0000 0 0x1000>;
	};

	simif1@800d0000 {
		compatible = "mediatek,simif1";
		reg = <0 0x800d0000 0 0x1000>;
	};

	md_mbist_config@800e0000 {
		compatible = "mediatek,md_mbist_config";
		reg = <0 0x800e0000 0 0x1000>;
	};

	md_pll_mixedsys@80120000 {
		compatible = "mediatek,md_pll_mixedsys";
		reg = <0 0x80120000 0 0x1000>;
	};

	md1_abb_mixedsys@80130000 {
		compatible = "mediatek,md1_abb_mixedsys";
		reg = <0 0x80130000 0 0x1000>;
	};

	md2_abb_mixedsys@80130000 {
		compatible = "mediatek,md2_abb_mixedsys";
		reg = <0 0x80130000 0 0x1000>;
	};

	md_abm@80140000 {
		compatible = "mediatek,md_abm";
		reg = <0 0x80140000 0 0x1000>;
	};

	md_adoe@80150000 {
		compatible = "mediatek,md_adoe";
		reg = <0 0x80150000 0 0x1000>;
	};

	idma@82000000 {
		compatible = "mediatek,idma";
		reg = <0 0x82000000 0 0x1000>;
	};

	ahb2dspio@82800000 {
		compatible = "mediatek,ahb2dspio";
		reg = <0 0x82800000 0 0x1000>;
	};

	md2g_confg@82c00000 {
		compatible = "mediatek,md2g_confg";
		reg = <0 0x82c00000 0 0x1000>;
	};

	apc@82c30000 {
		compatible = "mediatek,apc";
		reg = <0 0x82c30000 0 0x1000>;
	};

	csd_acc@82c70000 {
		compatible = "mediatek,csd_acc";
		reg = <0 0x82c70000 0 0x1000>;
	};

	share_d1@82ca0000 {
		compatible = "mediatek,share_d1";
		reg = <0 0x82ca0000 0 0x1000>;
	};

	irdma@82cb0000 {
		compatible = "mediatek,irdma";
		reg = <0 0x82cb0000 0 0x1000>;
	};

	patch@82cc0000 {
		compatible = "mediatek,patch";
		reg = <0 0x82cc0000 0 0x1000>;
	};

	mdafe@82cd0000 {
		compatible = "mediatek,mdafe";
		reg = <0 0x82cd0000 0 0x1000>;
	};

	bfe@82ce0000 {
		compatible = "mediatek,bfe";
		reg = <0 0x82ce0000 0 0x1000>;
	};

	modem_confg@83000000 {
		compatible = "mediatek,modem_confg";
		reg = <0 0x83000000 0 0x1000>;
	};

	modem2g_topsm@83010000 {
		compatible = "mediatek,modem2g_topsm";
		reg = <0 0x83010000 0 0x1000>;
	};

	tdma@83020000 {
		compatible = "mediatek,tdma";
		reg = <0 0x83020000 0 0x1000>;
	};

	shreg2@83030000 {
		compatible = "mediatek,shreg2";
		reg = <0 0x83030000 0 0x1000>;
	};

	divider@83040000 {
		compatible = "mediatek,divider";
		reg = <0 0x83040000 0 0x1000>;
	};

	fcs@83050000 {
		compatible = "mediatek,fcs";
		reg = <0 0x83050000 0 0x1000>;
	};

	gcu@83060000 {
		compatible = "mediatek,gcu";
		reg = <0 0x83060000 0 0x1000>;
	};

	bsi@83070000 {
		compatible = "mediatek,bsi";
		reg = <0 0x83070000 0 0x1000>;
	};

	bpi@83080000 {
		compatible = "mediatek,bpi";
		reg = <0 0x83080000 0 0x1000>;
	};

	afc@83090000 {
		compatible = "mediatek,afc";
		reg = <0 0x83090000 0 0x1000>;
	};

	wcdma_timer@830a0000 {
		compatible = "mediatek,wcdma_timer";
		reg = <0 0x830a0000 0 0x1000>;
	};

	dpa_bc@830b0000 {
		compatible = "mediatek,dpa_bc";
		reg = <0 0x830b0000 0 0x1000>;
	};

	pfc_encode@830c0000 {
		compatible = "mediatek,pfc_encode";
		reg = <0 0x830c0000 0 0x1000>;
	};

	pfc_decode@830d0000 {
		compatible = "mediatek,pfc_decode";
		reg = <0 0x830d0000 0 0x1000>;
	};

	hspasys_1_confg@83200000 {
		compatible = "mediatek,hspasys_1_confg";
		reg = <0 0x83200000 0 0x1000>;
	};

	hseq@83210000 {
		compatible = "mediatek,hseq";
		reg = <0 0x83210000 0 0x1000>;
	};

	hsce@83220000 {
		compatible = "mediatek,hsce";
		reg = <0 0x83220000 0 0x1000>;
	};

	hspasys_1_mbist@83230000 {
		compatible = "mediatek,hspasys_1_mbist";
		reg = <0 0x83230000 0 0x1000>;
	};

	hspasys_2_confg@83400000 {
		compatible = "mediatek,hspasys_2_confg";
		reg = <0 0x83400000 0 0x1000>;
	};

	hseq_dc@83410000 {
		compatible = "mediatek,hseq_dc";
		reg = <0 0x83410000 0 0x1000>;
	};

	hsce_dc@83420000 {
		compatible = "mediatek,hsce_dc";
		reg = <0 0x83420000 0 0x1000>;
	};

	rake_dc@83430000 {
		compatible = "mediatek,rake_dc";
		reg = <0 0x83430000 0 0x1000>;
	};

	hspasys_2_mbist@83440000 {
		compatible = "mediatek,hspasys_2_mbist";
		reg = <0 0x83440000 0 0x1000>;
	};

	uea_uia_u0@83600000 {
		compatible = "mediatek,uea_uia_u0";
		reg = <0 0x83600000 0 0x1000>;
	};

	uea_uia_u1@83610000 {
		compatible = "mediatek,uea_uia_u1";
		reg = <0 0x83610000 0 0x1000>;
	};

	dpa_rlc@83620000 {
		compatible = "mediatek,dpa_rlc";
		reg = <0 0x83620000 0 0x1000>;
	};

	dpa_mac@83630000 {
		compatible = "mediatek,dpa_mac";
		reg = <0 0x83630000 0 0x1000>;
	};

	upa@83640000 {
		compatible = "mediatek,upa";
		reg = <0 0x83640000 0 0x1000>;
	};

	h_rxbrp@83650000 {
		compatible = "mediatek,h_rxbrp";
		reg = <0 0x83650000 0 0x1000>;
	};

	rxbrp@83660000 {
		compatible = "mediatek,rxbrp";
		reg = <0 0x83660000 0 0x1000>;
	};

	hspasys_3_confg@83670000 {
		compatible = "mediatek,hspasys_3_confg";
		reg = <0 0x83670000 0 0x1000>;
	};

	txbrp@83680000 {
		compatible = "mediatek,txbrp";
		reg = <0 0x83680000 0 0x1000>;
	};

	txcrp@83690000 {
		compatible = "mediatek,txcrp";
		reg = <0 0x83690000 0 0x1000>;
	};

	h_txbrp@836a0000 {
		compatible = "mediatek,h_txbrp";
		reg = <0 0x836a0000 0 0x1000>;
	};

	txupc@836b0000 {
		compatible = "mediatek,txupc";
		reg = <0 0x836b0000 0 0x1000>;
	};

	bc@836c0000 {
		compatible = "mediatek,bc";
		reg = <0 0x836c0000 0 0x1000>;
	};

	dbg_tx@836d0000 {
		compatible = "mediatek,dbg_tx";
		reg = <0 0x836d0000 0 0x1000>;
	};

	hspasys_3_mbist@836e0000 {
		compatible = "mediatek,hspasys_3_mbist";
		reg = <0 0x836e0000 0 0x1000>;
	};

	rxsrp@83800000 {
		compatible = "mediatek,rxsrp";
		reg = <0 0x83800000 0 0x1000>;
	};

	indec@83810000 {
		compatible = "mediatek,indec";
		reg = <0 0x83810000 0 0x1000>;
	};

	rake_0@83820000 {
		compatible = "mediatek,rake_0";
		reg = <0 0x83820000 0 0x1000>;
	};

	rake_1@83830000 {
		compatible = "mediatek,rake_1";
		reg = <0 0x83830000 0 0x1000>;
	};

	rake_2@83840000 {
		compatible = "mediatek,rake_2";
		reg = <0 0x83840000 0 0x1000>;
	};

	searcher@83850000 {
		compatible = "mediatek,searcher";
		reg = <0 0x83850000 0 0x1000>;
	};

	rxdfe@83860000 {
		compatible = "mediatek,rxdfe";
		reg = <0 0x83860000 0 0x1000>;
	};

	hspasys_4_confg@83870000 {
		compatible = "mediatek,hspasys_4_confg";
		reg = <0 0x83870000 0 0x1000>;
	};

	dbg@83880000 {
		compatible = "mediatek,dbg";
		reg = <0 0x83880000 0 0x1000>;
	};

	dwrap0@83890000 {
		compatible = "mediatek,dwrap0";
		reg = <0 0x83890000 0 0x1000>;
	};

	log3g@838a0000 {
		compatible = "mediatek,log3g";
		reg = <0 0x838a0000 0 0x1000>;
	};

	hspasys_4_mbist@838b0000 {
		compatible = "mediatek,hspasys_4_mbist";
		reg = <0 0x838b0000 0 0x1000>;
	};

	dwrap1@838c0000 {
		compatible = "mediatek,dwrap1";
		reg = <0 0x838c0000 0 0x1000>;
	};

	tdd@84000000 {
		compatible = "mediatek,tdd";
		reg = <0 0x84000000 0 0x1000>;
	};

	mt_pmic_regulator {
		compatible = "mediatek,mt_pmic";
		buck_regulators {
			compatible = "mediatek,mt_pmic_buck_regulators";
			mt_pmic_vpa_buck_reg: buck_vpa {
				regulator-name = "vpa";
				regulator-min-microvolt = <500000>;
				regulator-max-microvolt = <3650000>;
				regulator-ramp-delay = <50000>;
				regulator-enable-ramp-delay = <180>;
			};
			mt_pmic_vproc_buck_reg: buck_vproc {
				regulator-name = "vproc";
				regulator-min-microvolt = <700000>;
				regulator-max-microvolt = <1493750>;
				regulator-ramp-delay = <6250>;
				regulator-enable-ramp-delay = <180>;
				regulator-always-on;
				regulator-boot-on;
			};
		};	/* End of buck_regulators */
		ldo_regulators {
			compatible = "mediatek,mt_pmic_ldo_regulators";
			mt_pmic_vcn28_ldo_reg: ldo_vcn28 {
				regulator-name = "vcn28";
				regulator-min-microvolt = <1800000>;
				regulator-max-microvolt = <2800000>;
				regulator-enable-ramp-delay = <264>;
			};
			mt_pmic_vtcxo_ldo_reg: ldo_vtcxo {
				regulator-name = "vtcxo";
				regulator-min-microvolt = <2200000>;
				regulator-max-microvolt = <2200000>;
				regulator-enable-ramp-delay = <110>;
			};
			mt_pmic_va_ldo_reg: ldo_va {
				regulator-name = "va";
				regulator-min-microvolt = <1800000>;
				regulator-max-microvolt = <2500000>;
				regulator-enable-ramp-delay = <110>;
			};
			mt_pmic_vcama_ldo_reg: ldo_vcama {
				regulator-name = "vcama";
				regulator-min-microvolt = <1500000>;
				regulator-max-microvolt = <2800000>;
				regulator-enable-ramp-delay = <264>;
			};
			mt_pmic_vcn33_bt_ldo_reg: ldo_vcn33_bt {
				regulator-name = "vcn33_bt";
				regulator-min-microvolt = <3300000>;
				regulator-max-microvolt = <3600000>;
				regulator-enable-ramp-delay = <264>;
			};
			mt_pmic_vcn33_wifi_ldo_reg: ldo_vcn33_wifi {
				regulator-name = "vcn33_wifi";
				regulator-min-microvolt = <3300000>;
				regulator-max-microvolt = <3600000>;
				regulator-enable-ramp-delay = <264>;
			};
			mt_pmic_vio28_ldo_reg: ldo_vio28 {
				regulator-name = "vio28";
				regulator-min-microvolt = <2800000>;
				regulator-max-microvolt = <2800000>;
				regulator-enable-ramp-delay = <264>;
				regulator-boot-on;
			};
			mt_pmic_vsim1_ldo_reg: ldo_vsim1 {
				regulator-name = "vsim1";
				regulator-min-microvolt = <1800000>;
				regulator-max-microvolt = <3000000>;
				regulator-enable-ramp-delay = <264>;
			};
			mt_pmic_vsim2_ldo_reg: ldo_vsim2 {
				regulator-name = "vsim2";
				regulator-min-microvolt = <1800000>;
				regulator-max-microvolt = <3000000>;
				regulator-enable-ramp-delay = <264>;
			};
			mt_pmic_vusb_ldo_reg: ldo_vusb {
				regulator-name = "vusb";
				regulator-min-microvolt = <3300000>;
				regulator-max-microvolt = <3300000>;
				regulator-enable-ramp-delay = <264>;
				regulator-boot-on;
			};
			mt_pmic_vgp1_ldo_reg: ldo_vgp1 {
				regulator-name = "vgp1";
				regulator-min-microvolt = <1200000>;
				regulator-max-microvolt = <3300000>;
				regulator-enable-ramp-delay = <264>;
			};
			mt_pmic_vgp2_ldo_reg: ldo_vgp2 {
				regulator-name = "vgp2";
				regulator-min-microvolt = <1200000>;
				regulator-max-microvolt = <3000000>;
				regulator-enable-ramp-delay = <264>;
			};
			mt_pmic_vemc_3v3_ldo_reg: ldo_vemc_3v3 {
				regulator-name = "vemc_3v3";
				regulator-min-microvolt = <3000000>;
				regulator-max-microvolt = <3300000>;
				regulator-enable-ramp-delay = <264>;
				regulator-boot-on;
			};
			mt_pmic_vcamaf_ldo_reg: ldo_vcamaf {
				regulator-name = "vcamaf";
				regulator-min-microvolt = <1200000>;
				regulator-max-microvolt = <3300000>;
				regulator-enable-ramp-delay = <264>;
			};
			mt_pmic_vmc_ldo_reg: ldo_vmc {
				regulator-name = "vmc";
				regulator-min-microvolt = <1800000>;
				regulator-max-microvolt = <3300000>;
				regulator-enable-ramp-delay = <44>;
			};
			mt_pmic_vmch_ldo_reg: ldo_vmch {
				regulator-name = "vmch";
				regulator-min-microvolt = <3000000>;
				regulator-max-microvolt = <3300000>;
				regulator-enable-ramp-delay = <44>;
			};
			mt_pmic_vibr_ldo_reg: ldo_vibr {
				regulator-name = "vibr";
				regulator-min-microvolt = <1200000>;
				regulator-max-microvolt = <3300000>;
				regulator-enable-ramp-delay = <44>;
			};
			mt_pmic_vrtc_ldo_reg: ldo_vrtc {
				regulator-name = "vrtc";
				regulator-min-microvolt = <2800000>;
				regulator-max-microvolt = <2800000>;
				regulator-enable-ramp-delay = <44>;
			};
			mt_pmic_vm_ldo_reg: ldo_vm {
				regulator-name = "vm";
				regulator-min-microvolt = <1200000>;
				regulator-max-microvolt = <1800000>;
				regulator-enable-ramp-delay = <264>;
				regulator-boot-on;
			};
			mt_pmic_vrf18_ldo_reg: ldo_vrf18 {
				regulator-name = "vrf18";
				regulator-min-microvolt = <1800000>;
				regulator-max-microvolt = <1800000>;
				regulator-enable-ramp-delay = <220>;
			};
			mt_pmic_vio18_ldo_reg: ldo_vio18 {
				regulator-name = "vio18";
				regulator-min-microvolt = <1800000>;
				regulator-max-microvolt = <1800000>;
				regulator-enable-ramp-delay = <264>;
				regulator-boot-on;
			};
			mt_pmic_vcamd_ldo_reg: ldo_vcamd {
				regulator-name = "vcamd";
				regulator-min-microvolt = <1200000>;
				regulator-max-microvolt = <1800000>;
				regulator-enable-ramp-delay = <264>;
			};
			mt_pmic_vcamio_ldo_reg: ldo_vcamio {
				regulator-name = "vcamio";
				regulator-min-microvolt = <1800000>;
				regulator-max-microvolt = <1800000>;
				regulator-enable-ramp-delay = <220>;
			};
			mt_pmic_vgp3_ldo_reg: ldo_vgp3 {
				regulator-name = "vgp3";
				regulator-min-microvolt = <1200000>;
				regulator-max-microvolt = <1800000>;
				regulator-enable-ramp-delay = <264>;
			};
			mt_pmic_vcn_1v8_ldo_reg: ldo_vcn_1v8 {
			regulator-name = "vcn_1v8";
				regulator-min-microvolt = <1800000>;
				regulator-max-microvolt = <1800000>;
				regulator-enable-ramp-delay = <44>;
			};

			mt_pmic_vcanio_ldo_reg:vcanio_ldo_reg {
			};
			mt_pmic_vcn33_ldo_reg:vcn33_ldo_reg {
			};
		};/* End of ldo_regulators */
		regulators_supply {
			compatible = "mediatek,mt_pmic_regulator_supply";
			vcn28-supply = <&mt_pmic_vcn28_ldo_reg>;
			vtcxo-supply = <&mt_pmic_vtcxo_ldo_reg>;
			va-supply = <&mt_pmic_va_ldo_reg>;
			vcn33_bt-supply = <&mt_pmic_vcn33_bt_ldo_reg>;
			vcn33_wifi-supply = <&mt_pmic_vcn33_wifi_ldo_reg>;
			vio28-supply = <&mt_pmic_vio28_ldo_reg>;
			vsim1-supply = <&mt_pmic_vsim1_ldo_reg>;
			vsim2-supply = <&mt_pmic_vsim2_ldo_reg>;
			vusb-supply = <&mt_pmic_vusb_ldo_reg>;
			vgp1-supply = <&mt_pmic_vgp1_ldo_reg>;
			vgp2-supply = <&mt_pmic_vgp2_ldo_reg>;
			vemc_3v3-supply = <&mt_pmic_vemc_3v3_ldo_reg>;
			vcamaf-supply = <&mt_pmic_vcamaf_ldo_reg>;
			vmc-supply = <&mt_pmic_vmc_ldo_reg>;
			vmch-supply = <&mt_pmic_vmch_ldo_reg>;
			vibr-supply = <&mt_pmic_vibr_ldo_reg>;
			vrtc-supply = <&mt_pmic_vrtc_ldo_reg>;
			vm-supply = <&mt_pmic_vm_ldo_reg>;
			vrf18-supply = <&mt_pmic_vrf18_ldo_reg>;
			vio18-supply = <&mt_pmic_vio18_ldo_reg>;
			vcamd-supply = <&mt_pmic_vcamd_ldo_reg>;
			vcamio-supply = <&mt_pmic_vcamio_ldo_reg>;
			vgp3-supply = <&mt_pmic_vgp3_ldo_reg>;
			vcn_1v8-supply = <&mt_pmic_vcn_1v8_ldo_reg>;
		};/* End of regulators_supply */
	};/* End of mt_pmic_regulator */

	mtkfb: mtkfb@0 {
		compatible = "mediatek,mtkfb";
	};

	dsi_te: dsi_te {
		compatible = "mediatek, dsi_te-eint";
	};

	rf_clock_buffer_ctrl:rf_clock_buffer {
		compatible = "mediatek,rf_clock_buffer";
		#mediatek,clkbuf-quantity = <4>;
		#mediatek,clkbuf-config = <2 1 1 1>;
	};

	bat_meter: bat_meter {
		compatible = "mediatek,bat_meter";
	};

	BAT_NOTIFY {
		compatible = "mediatek,bat_notify";
	};

	bat_comm: bat_comm {
		compatible = "mediatek,battery";
	};

	otg_iddig:otg_iddig {
				compatible = "mediatek,usb_iddig_eint";
	};

	firmware {
		android {
			compatible = "android,firmware";
			fstab {
				compatible = "android,fstab";
#ifndef CONFIG_MTK_AB_OTA_UPDATER
				system {
					compatible = "android,system";
					dev = "/dev/block/platform/mtk-msdc.0/11120000.msdc0/by-name/system";
					type = "ext4";
					mnt_flags = "ro";
					#ifndef CONFIG_MTK_DM_VERITY_OFF
					fsmgr_flags = "wait,verify";
					#else
					fsmgr_flags = "wait";
					#endif
				};
#endif
#ifndef CONFIG_MTK_LATE_MOUNT
				vendor {
					compatible = "android,vendor";
					dev = "/dev/block/platform/mtk-msdc.0/11120000.msdc0/by-name/vendor";
					type = "ext4";
					mnt_flags = "ro";
#ifndef CONFIG_MTK_AB_OTA_UPDATER
					#ifndef CONFIG_MTK_DM_VERITY_OFF
					fsmgr_flags = "wait,verify";
					#else
					fsmgr_flags = "wait";
					#endif
#else
					#ifndef CONFIG_MTK_DM_VERITY_OFF
					fsmgr_flags = "wait,slotselect,verify";
					#else
					fsmgr_flags = "wait,slotselect";
					#endif
#endif
				};
#endif
#ifdef CONFIG_TARGET_COPY_OUT_ODM
				odm {
					compatible = "android,odm";
					dev = "/dev/block/platform/mtk-msdc.0/11120000.msdc0/by-name/odm";
					type = "ext4";
					mnt_flags = "ro";
#ifndef CONFIG_MTK_AB_OTA_UPDATER
					fsmgr_flags = "wait";
#else
					fsmgr_flags = "wait,slotselect";
#endif
				};
#endif
			};
		};
	};

	odm: odm{
		compatible = "simple-bus";
		/* reserved for overlay by odm */
	};

	bus: bus {
		compatible = "simple-bus";
		#address-cells = <1>;
		#size-cells = <1>;
		ranges = <0 0 0 0xffffffff>;
	};
};

#include <trusty.dtsi>
