## Documentation/devicetree/bindings/arm/mediatek/mediatek,ISP_SYSR.txt
```
Mediatek imgsys controller
============================

The Mediatek imgsys controller provides various clocks to the system.

Required Properties:

- compatible: Should be one of:
	- "mediatek,mt2701-imgsys", "syscon"
	- "mediatek,mt8173-imgsys", "syscon"
- #clock-cells: Must be 1

The imgsys controller uses the common clk binding from
Documentation/devicetree/bindings/clock/clock-bindings.txt
The available clocks are defined in dt-bindings/clock/mt*-clk.h.

Example:

ISP_SYSR: ISP_SYSR@0x15000000 {
	compatible = "mediatek,ISP_SYSR";
	#clock-cells = <1>;
};
```

## arch/arm/configs/k80hd_bsp_fwv_512m_debug_defconfig
```kconfig
CONFIG_MACH_MT6580=y
CONFIG_CROSS_COMPILE="arm-eabi-"
# CONFIG_LOCALVERSION_AUTO is not set
# CONFIG_FHANDLE is not set
CONFIG_PSI=y
CONFIG_LOG_BUF_SHIFT=18
# CONFIG_RD_BZIP2 is not set
# CONFIG_RD_LZMA is not set
# CONFIG_RD_XZ is not set
# CONFIG_RD_LZO is not set
# CONFIG_RD_LZ4 is not set
# CONFIG_SLUB_DEBUG is not set
CONFIG_OPROFILE=y
CONFIG_CC_STACKPROTECTOR_STRONG=y
# CONFIG_BLK_DEV_BSG is not set
CONFIG_SMP=y
CONFIG_HAVE_ARM_ARCH_TIMER=y
CONFIG_PREEMPT=y
CONFIG_AEABI=y
CONFIG_HIGHMEM=y
# CONFIG_BOUNCE is not set
CONFIG_CMA_AREAS=1
CONFIG_ZSMALLOC=y
CONFIG_BUILD_ARM_APPENDED_DTB_IMAGE=y
CONFIG_BUILD_ARM_APPENDED_DTB_IMAGE_NAMES="mt6580"
CONFIG_BUILD_ARM_DTB_OVERLAY_IMAGE_NAMES="k80hd_bsp_fwv_512m"
CONFIG_CMDLINE="console=tty0 console=ttyMT3,921600n1 root=/dev/ram vmalloc=496M slub_max_order=0 slub_debug=O "
CONFIG_CPU_FREQ=y
CONFIG_CPU_FREQ_DEFAULT_GOV_INTERACTIVE=y
CONFIG_CPU_FREQ_GOV_POWERSAVE=y
CONFIG_CPU_FREQ_GOV_USERSPACE=y
CONFIG_CPU_FREQ_GOV_ONDEMAND=y
CONFIG_VFP=y
CONFIG_NEON=y
# CONFIG_CORE_DUMP_DEFAULT_ELF_HEADERS is not set
CONFIG_XFRM_MIGRATE=y
CONFIG_IP_PNP=y
CONFIG_IP_PNP_DHCP=y
CONFIG_IP_PNP_BOOTP=y
CONFIG_NET_IPIP=y
CONFIG_IP_MROUTE=y
CONFIG_IP_MROUTE_MULTIPLE_TABLES=y
CONFIG_IP_PIMSM_V1=y
CONFIG_IP_PIMSM_V2=y
CONFIG_SYN_COOKIES=y
CONFIG_IPV6_SIT_6RD=y
CONFIG_IPV6_SUBTREES=y
CONFIG_IPV6_MROUTE=y
CONFIG_IPV6_PIMSM_V2=y
CONFIG_NETFILTER_XT_MATCH_CONNBYTES=y
CONFIG_NETFILTER_XT_MATCH_MULTIPORT=y
CONFIG_NETFILTER_XT_MATCH_PHYSDEV=m
CONFIG_NETFILTER_XT_MATCH_QUOTA2_LOG=y
CONFIG_NETFILTER_XT_MATCH_REALM=y
CONFIG_NETFILTER_XT_MATCH_RECENT=y
CONFIG_NETFILTER_XT_MATCH_TCPMSS=y
CONFIG_IP6_NF_MATCH_FRAG=y
CONFIG_IP6_NF_MATCH_IPV6HEADER=y
CONFIG_IP6_NF_TARGET_HL=y
CONFIG_BRIDGE=y
CONFIG_VLAN_8021Q=y
CONFIG_NET_SCH_INGRESS=y
CONFIG_NET_CLS_FW=y
CONFIG_CLS_U32_PERF=y
CONFIG_CLS_U32_MARK=y
CONFIG_NET_CLS_FLOW=y
CONFIG_NET_ACT_POLICE=y
CONFIG_NET_ACT_MIRRED=y
CONFIG_NET_ACT_IPT=y
CONFIG_NET_CLS_IND=y
CONFIG_CFG80211=y
CONFIG_NL80211_TESTMODE=y
CONFIG_CFG80211_DEVELOPER_WARNINGS=y
# CONFIG_CFG80211_DEFAULT_PS is not set
CONFIG_CFG80211_DEBUGFS=y
CONFIG_CFG80211_INTERNAL_REGDB=y
CONFIG_MTK_NET_LOGGING=y
CONFIG_EXTREME_LOW_RAM=y
CONFIG_BLK_DEV_LOOP=y
CONFIG_BLK_DEV_LOOP_MIN_COUNT=16
CONFIG_MEDIATEK_SOLUTION=y
CONFIG_MTK_PLATFORM="mt6580"
CONFIG_ARCH_MTK_PROJECT="k80hd_bsp_fwv_512m"
CONFIG_MTK_GPT_SCHEME_SUPPORT=y
CONFIG_MTK_FREQ_HOPPING=y
CONFIG_MTK_CLKMGR=y
CONFIG_MTK_PMIC_WRAP_HAL=y
CONFIG_MTK_THERMAL_PA_VIA_ATCMD=y
CONFIG_CUSTOM_KERNEL_IMGSENSOR="imx179_mipi_raw_5mp ov5670_mipi_raw_3mp"
CONFIG_MTK_VIDEOCODEC_DRIVER=y
# CONFIG_MMPROFILE is not set
CONFIG_MTK_CMDQ=y
CONFIG_MTK_IMGSENSOR=y
CONFIG_MTK_LCM=y
CONFIG_CUSTOM_KERNEL_LCM="hx8392a_dsi_cmd_fwvgap"
CONFIG_MTK_SYNC=y
CONFIG_MTK_FB=y
CONFIG_MTK_VIDEOX=y
CONFIG_MTK_LCM_PHYSICAL_ROTATION="0"
CONFIG_LCM_HEIGHT="960"
CONFIG_LCM_WIDTH="480"
CONFIG_MTK_SENSOR_SUPPORT=y
CONFIG_MTK_SENSORS_1_0=y
CONFIG_CUSTOM_KERNEL_ACCELEROMETER=y
CONFIG_MTK_MC3410_I2C=y
CONFIG_CUSTOM_KERNEL_ALSPS=y
CONFIG_MTK_CM36652=y
CONFIG_CUSTOM_KERNEL_GYROSCOPE=y
CONFIG_MTK_ITG1010=y
CONFIG_CUSTOM_KERNEL_MAGNETOMETER=y
CONFIG_MTK_AKM09911=y
CONFIG_MTK_HWMON=y
CONFIG_MTK_BTCVSD=y
CONFIG_MTK_MD1_SUPPORT=3
CONFIG_MTK_MD2_SUPPORT=0
CONFIG_MTK_COMBO=y
CONFIG_MTK_COMBO_CHIP_CONSYS_6580=y
CONFIG_MTK_COMBO_BT=y
CONFIG_MTK_COMBO_GPS=y
CONFIG_MTK_COMBO_WIFI=y
CONFIG_MTK_GPS_SUPPORT=y
CONFIG_MTK_FMRADIO=y
CONFIG_MTK_FM_CHIP="MT6580_FM"
CONFIG_MTK_CCCI_EXT=y
CONFIG_MTK_CCCI_DRIVER=y
CONFIG_MTK_BTIF=y
CONFIG_MTK_SECURITY_SW_SUPPORT=y
CONFIG_MTK_ACCDET=y
CONFIG_ACCDET_EINT=y
CONFIG_MTK_DEVAPC_DRIVER=y
CONFIG_MTK_DEBUGSYS_LOCK=y
CONFIG_MTK_IRQ=y
CONFIG_MTK_LEDS=y
CONFIG_MTK_PWM=y
CONFIG_MTK_SERIAL=y
CONFIG_MTK_VIBRATOR=y
CONFIG_MTK_CHIP=y
CONFIG_MTK_LOAD_BALANCE_ENHANCEMENT=y
CONFIG_MTK_SCHED_RQAVG_KS=y
CONFIG_MTK_SCHED_RQAVG_US=y
CONFIG_MTK_SYSENV=y
CONFIG_MTK_GPU_SUPPORT=y
CONFIG_MTK_GPU_VERSION="mali utgard r10p0-01dev0"
CONFIG_MTK_RTC=y
CONFIG_MTK_RAM_CONSOLE=y
CONFIG_MTK_AEE_FEATURE=y
CONFIG_MTK_LENS=y
CONFIG_MTK_LENS_DUMMYLENS_SUPPORT=y
CONFIG_MTK_LENS_AD5820AF_SUPPORT=y
CONFIG_MTK_LENS_DW9714AF_SUPPORT=y
CONFIG_MTK_LENS_LC898212AF_SUPPORT=y
CONFIG_MTK_FLASHLIGHT=y
CONFIG_MTK_FLASHLIGHT_LM3642=y
CONFIG_USB_MTK_HDRC=y
CONFIG_MTK_MEMCFG=y
CONFIG_MTPROF=y
CONFIG_MTK_SCHED_MONITOR=y
CONFIG_PREEMPT_MONITOR=y
CONFIG_MTK_WQ_DEBUG=y
CONFIG_MTK_RCU_MONITOR=y
CONFIG_ANDROID_DEFAULT_SETTING=y
CONFIG_SCSI=y
CONFIG_BLK_DEV_SD=y
CONFIG_SCSI_SCAN_ASYNC=y
# CONFIG_SCSI_LOWLEVEL is not set
CONFIG_MD=y
CONFIG_BLK_DEV_DM=y
CONFIG_DM_DEBUG=y
CONFIG_DM_CRYPT=y
CONFIG_DM_UEVENT=y
CONFIG_DM_VERITY=y
CONFIG_IFB=y
# CONFIG_ETHERNET is not set
CONFIG_PPP_FILTER=y
CONFIG_PPP_MULTILINK=y
CONFIG_PPPOE=y
CONFIG_PPP_ASYNC=y
CONFIG_PPP_SYNC_TTY=y
# CONFIG_INPUT_MOUSEDEV is not set
CONFIG_INPUT_EVDEV=y
# CONFIG_KEYBOARD_ATKBD is not set
CONFIG_KEYBOARD_MTK=y
CONFIG_ONEKEY_REBOOT_NORMAL_MODE=y
CONFIG_ONEKEY_REBOOT_OTHER_MODE=y
CONFIG_KPD_PWRKEY_USE_PMIC=y
# CONFIG_INPUT_MOUSE is not set
CONFIG_INPUT_TOUCHSCREEN=y
CONFIG_TOUCHSCREEN_MTK=y
CONFIG_TOUCHSCREEN_MTK_GT1151=y
CONFIG_GT1151_FIRMWARE="firmware1"
CONFIG_GT1151_CONFIG="config4"
CONFIG_GTP_DRIVER_SEND_CFG=y
CONFIG_GTP_CUSTOM_CFG=y
CONFIG_GTP_AUTO_UPDATE=y
CONFIG_GTP_HEADER_FW_UPDATE=y
CONFIG_GTP_CREATE_WR_NODE=y
CONFIG_GTP_POWER_CTRL_SLEEP=y
CONFIG_INPUT_MISC=y
CONFIG_INPUT_UINPUT=y
# CONFIG_SERIO is not set
# CONFIG_VT is not set
CONFIG_LEGACY_PTY_COUNT=16
# CONFIG_DEVMEM is not set
# CONFIG_DEVKMEM is not set
# CONFIG_HW_RANDOM is not set
CONFIG_SPI=y
CONFIG_MTK_SPI=y
CONFIG_POWER_RESET=y
CONFIG_MTK_SMART_BATTERY=y
CONFIG_MTK_KERNEL_POWER_OFF_CHARGING=y
# CONFIG_HWMON is not set
CONFIG_THERMAL=y
CONFIG_THERMAL_DEFAULT_GOV_BACKWARD_COMPATIBLE=y
CONFIG_WATCHDOG=y
CONFIG_REGULATOR=y
CONFIG_FB_MODE_HELPERS=y
CONFIG_FB_TILEBLITTING=y
CONFIG_SOUND=y
CONFIG_SND=y
CONFIG_SND_SEQUENCER=y
CONFIG_SND_MIXER_OSS=y
CONFIG_SND_PCM_OSS=y
CONFIG_SND_SEQUENCER_OSS=y
CONFIG_SND_DYNAMIC_MINORS=y
# CONFIG_SND_ARM is not set
# CONFIG_SND_SPI is not set
CONFIG_SND_USB_AUDIO=y
CONFIG_SND_SOC=y
CONFIG_MTK_SPEAKER=y
CONFIG_MT_SND_SOC_6580=y
CONFIG_SND_SIMPLE_CARD=y
CONFIG_SOUND_PRIME=y
CONFIG_HIDRAW=y
CONFIG_UHID=y
CONFIG_HID_A4TECH=y
CONFIG_HID_APPLE=y
CONFIG_HID_BELKIN=y
CONFIG_HID_CHERRY=y
CONFIG_HID_CHICONY=y
CONFIG_HID_CYPRESS=y
CONFIG_HID_DRAGONRISE=y
CONFIG_HID_EZKEY=y
CONFIG_HID_KYE=y
CONFIG_HID_GYRATION=y
CONFIG_HID_TWINHAN=y
CONFIG_HID_KENSINGTON=y
CONFIG_HID_LOGITECH=y
CONFIG_HID_MAGICMOUSE=y
CONFIG_HID_MICROSOFT=y
CONFIG_HID_MONTEREY=y
CONFIG_HID_PANTHERLORD=y
CONFIG_HID_PETALYNX=y
CONFIG_HID_SAMSUNG=y
CONFIG_HID_SUNPLUS=y
CONFIG_HID_GREENASIA=y
CONFIG_HID_SMARTJOYPLUS=y
CONFIG_HID_TOPSEED=y
CONFIG_HID_THRUSTMASTER=y
CONFIG_HID_ZEROPLUS=y
CONFIG_USB=y
CONFIG_USB_STORAGE=y
CONFIG_USB_STORAGE_DATAFAB=y
CONFIG_USB_STORAGE_FREECOM=y
CONFIG_USB_STORAGE_ISD200=y
CONFIG_USB_STORAGE_USBAT=y
CONFIG_USB_STORAGE_SDDR09=y
CONFIG_USB_STORAGE_SDDR55=y
CONFIG_USB_STORAGE_JUMPSHOT=y
CONFIG_USB_STORAGE_ALAUDA=y
CONFIG_USB_STORAGE_ONETOUCH=y
CONFIG_USB_STORAGE_KARMA=y
CONFIG_USB_STORAGE_CYPRESS_ATACB=y
CONFIG_USB_TRANCEVIBRATOR=y
CONFIG_NOP_USB_XCEIV=y
CONFIG_DUAL_ROLE_USB_INTF=y
CONFIG_USB_GADGET_VBUS_DRAW=500
CONFIG_USB_CONFIGFS_SERIAL=y
CONFIG_USB_CONFIGFS_ACM=y
CONFIG_USB_CONFIGFS_RNDIS=y
CONFIG_USB_CONFIGFS_MASS_STORAGE=y
CONFIG_USB_CONFIGFS_F_HID=y
CONFIG_MMC=y
CONFIG_MMC_BLOCK_MINORS=32
CONFIG_MMC_MTK_PRO=y
CONFIG_MTK_EMMC_SUPPORT=y
CONFIG_MTK_EMMC_CACHE=y
CONFIG_MTK_EMMC_SUPPORT_OTP=y
CONFIG_NEW_LEDS=y
CONFIG_LEDS_CLASS=y
CONFIG_LEDS_TRIGGERS=y
CONFIG_LEDS_TRIGGER_TIMER=y
# CONFIG_RTC_SYSTOHC is not set
CONFIG_SW_SYNC=y
CONFIG_MTK_GMO_RAM_OPTIMIZE=y
CONFIG_ANDROID_INTF_ALARM_DEV=y
CONFIG_ION=y
CONFIG_MTK_ION=y
CONFIG_EXT4_DEBUG=y
CONFIG_QUOTA=y
CONFIG_QUOTA_NETLINK_INTERFACE=y
CONFIG_QFMT_V2=y
CONFIG_FUSE_FS=y
CONFIG_ISO9660_FS=y
CONFIG_JOLIET=y
CONFIG_ZISOFS=y
CONFIG_MSDOS_FS=y
CONFIG_VFAT_FS=y
CONFIG_TMPFS=y
CONFIG_PSTORE=y
CONFIG_PSTORE_CONSOLE=y
CONFIG_PSTORE_PMSG=y
CONFIG_PSTORE_RAM=y
# CONFIG_NETWORK_FILESYSTEMS is not set
CONFIG_NLS_CODEPAGE_437=y
CONFIG_NLS_CODEPAGE_950=y
CONFIG_NLS_ASCII=y
CONFIG_NLS_ISO8859_1=y
CONFIG_NLS_UTF8=y
CONFIG_PRINTK_TIME=y
CONFIG_DEBUG_INFO=y
CONFIG_FRAME_WARN=2800
CONFIG_DEBUG_KMEMLEAK=y
CONFIG_DEBUG_KMEMLEAK_EARLY_LOG_SIZE=3200
CONFIG_DEBUG_KMEMLEAK_DEFAULT_OFF=y
CONFIG_DETECT_HUNG_TASK=y
CONFIG_PANIC_ON_OOPS=y
CONFIG_PANIC_TIMEOUT=5
CONFIG_SCHEDSTATS=y
CONFIG_PROVE_LOCKING=y
CONFIG_DEBUG_LOCKDEP=y
CONFIG_DEBUG_ATOMIC_SLEEP=y
CONFIG_DEBUG_LIST=y
CONFIG_RCU_CPU_STALL_TIMEOUT=60
CONFIG_RCU_TRACE=y
CONFIG_FAULT_INJECTION=y
CONFIG_ENABLE_DEFAULT_TRACERS=y
CONFIG_MTK_SCHED_TRACERS=y
CONFIG_MTK_FTRACE_DEFAULT_ENABLE=y
CONFIG_DMA_API_DEBUG=y
CONFIG_KGDB=y
CONFIG_KGDB_KDB=y
# CONFIG_ARM_UNWIND is not set
CONFIG_SECURITY_SELINUX_BOOTPARAM=y
CONFIG_CRYPTO_TWOFISH=y
CONFIG_CRYPTO_LZ4K=y
# CONFIG_CRYPTO_HW is not set
```

## drivers/block/zram/Kconfig
```kconfig
config ZRAM
	tristate "Compressed RAM block device support"
	depends on BLOCK && SYSFS && ZSMALLOC && CRYPTO
	select CRYPTO_LZO
	default n
	help
	  Creates virtual block devices called /dev/zramX (X = 0, 1, ...).
	  Pages written to these disks are compressed and stored in memory
	  itself. These disks allow very fast I/O and compression provides
	  good amounts of memory savings.

	  It has several use cases, for example: /tmp storage, use as swap
	  disks and maybe many more.
	  See zram.txt for more information.

config EXTREME_LOW_RAM
	bool "Support the device with memory smaller than 512M"
	default n
	help
	  This config decide if device memory < 512M
	  For 512M device, it has many low mem shrinking mechanism
	  Normal project will disable it first
	  If you are not sure about this, do not set it to y

config ZRAM_LZ4_COMPRESS
	bool "Enable LZ4 algorithm support"
	depends on ZRAM
	select LZ4_COMPRESS
	select CRYPTO_LZ4
	select CRYPTO_LZ4HC if EXTREME_LOW_RAM
	select LZ4_DECOMPRESS
	default n
	help
	  This option enables LZ4 compression algorithm support. Compression
	  algorithm can be changed using 'comp_algorithm' device attribute.
	  See Documentation/blockdev/zram.txt for more information.

config ZRAM_WRITEBACK
       bool "Write back incompressible or idle page to backing device"
       depends on ZRAM
       default n
       help
	 With incompressible page, there is no memory saving to keep it
	 in memory. Instead, write it out to backing device.
	 For this feature, admin should set up backing device via
	 /sys/block/zramX/backing_dev.

	 With /sys/block/zramX/{idle,writeback}, application could ask
	 idle page's writeback to the backing device to save in memory.

	 See Documentation/blockdev/zram.txt for more information.

config ZRAM_MEMORY_TRACKING
	bool "Track zRam block status"
	depends on ZRAM && DEBUG_FS
	help
	  With this feature, admin can track the state of allocated blocks
	  of zRAM. Admin could see the information via
	  /sys/kernel/debug/zram/zramX/block_state.

	  See Documentation/blockdev/zram.txt for more information.
```

## drivers/input/touchscreen/mediatek/Kconfig
```kconfig
#
# Touchscreen driver configuration
#
menuconfig INPUT_TOUCHSCREEN
	bool "Touchscreens"
	help
	  Say Y here, and a list of supported touchscreens will be displayed.
	  This option doesn't affect the kernel.

	  If unsure, say Y.

if INPUT_TOUCHSCREEN

config TOUCHSCREEN_MTK
	bool "MediaTek Touch Panel Driver"
	help
	  Say Y here if you have MediaTek touch panel.

	  If unsure, say N.

	  To compile this dirver as a module, choose M here: the
	  module will be called.

config TOUCHSCREEN_PHYSICAL_ROTATION_WITH_LCM
	bool "MediaTek Touch Panel Rotation With LCM"
	default y
	help
	  Say N here if touch panel is not physical rotated as LCM does.
	  Physically rotated means that this driver will map
	  the reported coordination to diagonal position.

	  If unsure, say Y.
config TOUCHSCREEN_MTK_SOLOMON
	bool "SOLOMON for Mediatek package"
	default n
	help
	  Say Y here if you have SOLOMON touch panel.

	  If unsure, say N.

	  To compile this dirver as a module, choose M here: the
	  module will be called.

source "drivers/input/touchscreen/mediatek/SOLOMON/Kconfig"

config TOUCHSCREEN_MTK_FOCALTECH_TS
	bool "FOCALTECH_TS for Mediatek package"
	default n
	help
	  Say Y here if you have focaltech_touch touch panel.

	  If unsure, say N.

	  To compile this dirver as a module, choose M here: the
	  module will be called.

source "drivers/input/touchscreen/mediatek/focaltech_touch/Kconfig"
config TOUCHSCREEN_MTK_GT1151
	bool "GT1151 for Mediatek package"
	default n
	help
	  Say Y here if you have GT1151 touch panel.

	  If unsure, say N.

	  To compile this dirver as a module, choose M here: the
	  module will be called.

source "drivers/input/touchscreen/mediatek/GT1151/Kconfig"

config TOUCHSCREEN_MTK_GT9XXTB_HN_NEW
	bool "GT9XXTB hotknot new driver for Mediatek package"
	default n
	help
	  This is new driver for goodix GT9XX series touch screen.
	  This driver upgrade FW with request_firmware method.
	  Say Y here if you use gt9xx series new touch driver.
	  If unsure, say N.

source "drivers/input/touchscreen/mediatek/gt9xxtb_hn_new/Kconfig"

config TOUCHSCREEN_MTK_NT36xxx
	bool "NT36xxx for Mediatek package"
	default n
	help
	  Say Y here if you have NT36xxx touch panel.

	  If unsure, say N.

	  To compile this dirver as a module, choose M here: the
	  module will be called.

source "drivers/input/touchscreen/mediatek/NT36xxx/Kconfig"


endif
```

## drivers/misc/mediatek/gpio/Kconfig
```kconfig
#
#Kconfig for mediatek/gpio
#
config MTK_GPIO
	tristate "MediaTek GPIO driver"
	default n
	---help---
	  This selects the MediaTek(R) GPIO driver.
	  If you want to use MediaTek(R) SPI interface, say Y or M here.
	  If unsure, say N.

config MTK_MT6306_GPIO_SUPPORT
	tristate "MediaTek MT6306 GPIO Controller support"
	default n
	---help---
	  This selects the MediaTek(R) MT6306 GPIO driver.
	  Some pinctrl functions need the utilities from this driver.
	  If you want to use MediaTek(R) GPIO driver, say Y or M here.
	  If unsure, say N.
```

## drivers/misc/mediatek/i2c/Kconfig
```kconfig
config MTK_I2C
	tristate "MediaTek I2C adapter"
	depends on I2C
	default y
	---help---
	  This selects the MediaTek(R) Integrated Inter Circuit bus driver.
	  MediaTek(R) I2C bus adapter is the base for some other I2C client, eg: touch, sensors.
	  If you want to use MediaTek(R) I2C interface, say Y or M here.
	  If unsure, say N.


config MTK_I2C_EXTENSION
	def_bool y if (MACH_MT6735 || MACH_MT6735M || MACH_MT6753 || MACH_MT6580 || MACH_MT6755)
	help
	  Select this if your platform need MTK i2c extension.
```

## drivers/misc/mediatek/sensors-1.0/alsps/epl259x-new/Kconfig
```kconfig
config MTK_EPL259X_NEW
	bool "epl259x for MediaTek package"
	default n
	help
	It support different type sensor
	in this platform. If this option
	is set, it will support ambient
	and light sensor epl259x.
```

## drivers/misc/mediatek/ssw/Kconfig
```kconfig
config CUSTOM_KERNEL_SSW
	string "CUSTOM_KERNEL_SSW"
	help
	  To choose kernel sim switch driver
	  ssw_single_v2: internal switcher for mt6735 serials
```
