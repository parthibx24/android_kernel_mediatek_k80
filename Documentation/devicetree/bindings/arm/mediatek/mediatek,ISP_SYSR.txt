## drivers/misc/mediatek/trng/Kconfig
```kconfig
config MTK_TRNG_DRIVER
	bool "Enable MTK TRNG driver"
	default y if (!FPGA_EARLY_PORTING) && (MACH_MT6580)
	help
	  TRNG contributes randomness to kernel
	  CRNG in boot process. This is required
	  when FBE is enabled. TRNG kernel driver
	  also creates procfs to dump random number
	  through SMC call in eng load.
```
